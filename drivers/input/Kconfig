## drivers/input/Kconfig
```kconfig
config INPUT_TPS43
    bool "Azoteq TPS43 I2C Touchpad Input Device"
    default y
    depends on I2C
    depends on INPUT
    help
      Enable the driver for the Azoteq TPS43 touchpad input device over I2C.
      Supports multi-touch gestures, scrolling, clicks, and power management.

if INPUT_TPS43

config INPUT_TPS43_INIT_PRIORITY
    int "Init priority"
    default 90
    help
      Initialization priority of the device driver.

endif # ZMK_SENSOR_TPS43
```

## dts/bindings/input/azoteq,tps43-common.yaml
```yaml
properties:
  rdy-gpios:
    type: phandle-array
    required: false
    description: GPIO pin for the RDY (Ready) interrupt signal

  rst-gpios:
    type: phandle-array
    required: false
    description: GPIO pin for the RST (Reset) signal

  filter-settings:
    type: int
    default: 0x0F
    description: |
      Bit definitions:
      - Bit 0 (0x01): IIR filter - infinite impulse response filter for
        coordinate smoothing. Reduces high-frequency noise and jitter.
      - Bit 1 (0x02): MAV filter - moving average filter for coordinate
        stabilization. Removes outliers and averages the most recent samples.
      - Bit 2 (0x04): IIR select - When set, a fixed IIR coefficient is used.
        When cleared (default), a dynamic IIR is used that adapts to the movement speed.
      - Bit 3 (0x08): ALP count filter - Adaptive learning process filter
        for noise suppression. Filters out unwanted touch events based on learned patterns.

      Common configurations:
      - 0x0B: IIR + MAV + ALP enabled, dynamic IIR.
        A good balance of stability and responsiveness.
      - 0x0F (default): All filters enabled, including the fixed IIR select.
        Maximum smoothing, may increase latency.
      - 0x03: IIR + MAV only. Basic smoothing without ALP filtering.
      - 0x01: IIR only. Minimal filtering, lowest latency.
      - 0x00: All filters disabled. Raw sensor data may contain noise.

      Values can be combined with a bitwise OR (for example, 0x01 | 0x02 = 0x03).

  sensitivity:
    type: int
    required: false
    default: 100
    description: Touch sensitivity percentage (100 = normal, higher = more sensitive)

  scroll-sensitivity:
    type: int
    required: false
    default: 50
    description: Scroll sensitivity percentage (50 = normal, higher = more sensitive)

  report-rate-ms:
    type: int
    required: false
    default: 10
    description: |
      Report period (ms) for the active, idle-touch, and idle modes. 10 = 100 Hz.
      Set identically for all modes so that slow movements do not use the
      slow report rate (eliminates stutter). 0 = keep the chip's default value.

  x-resolution:
    type: int
    required: false
    default: 2048
    description: |
      Hardware resolution along the X axis. Higher = faster cursor without software
      gain (less jitter). 0 = keep the chip's default value.

  y-resolution:
    type: int
    required: false
    default: 1792
    description: |
      Hardware resolution along the Y axis. Higher = faster cursor without software
      gain (less jitter). 0 = keep the chip's default value.

  enable-power-management:
    type: boolean
    required: false
    description: Enable automatic power management (suspend/resume)

  single-tap:
    type: boolean
    required: false
    description: Enable the single-tap gesture

  two-finger-tap:
    type: boolean
    required: false
    description: Enable the two-finger tap gesture

  scroll:
    type: boolean
    required: false
    description: Enable the scroll gesture

  swipes:
    type: boolean
    required: false
    description: Enable swipe handling. When enabled, three-finger swipes are tracked

  switch-xy:
    type: boolean
    required: false
    description: Swap the X and Y axes

  press-and-hold:
    type: boolean
    required: false
    description: Enable the press-and-hold gesture

  invert-x:
    type: boolean
    description: If present, invert the X coordinate values.

  invert-y:
    type: boolean
    description: If present, invert the Y coordinate values.

  invert-scroll-x:
    type: boolean
    description: If present, invert the scroll values along X.

  invert-scroll-y:
    type: boolean
    description: If present, invert the scroll values along Y.
```

## dts/bindings/input/azoteq,tps43-i2c.yaml
```yaml
description: |
  Azoteq TPS43 touchpad sensor driver over I2C

compatible: "azoteq,tps43"

include: ["i2c-device.yaml", "azoteq,tps43-common.yaml"]
```
